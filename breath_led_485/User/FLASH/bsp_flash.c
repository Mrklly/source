#include "bsp_flash.h"
/*****************************************************************************************************
*程序名：FLASH_Init
***功能：初始化内部flash
***参数：无参数。
*返回值：无返回值。
***作者：王利均
***时间：2018年4月23号。
*****************************************************************************************************/
void flash_Init(void)
{
  FLASH_DeInit();                                       //复位EEPROM寄存器
  FLASH_SetProgrammingTime(FLASH_PROGRAMTIME_STANDARD); //标准编程时间。
  FLASH_Unlock(FLASH_MEMTYPE_DATA);                     //解锁对DATA eeprom内存进行操作。
}
/*****************************************************************************************************
*程序名：flash_read
***功能：读取flash指定长度的数据。
***参数：参数1：要读取的地址，参数2：数据缓存，参数3：读取数据长度。
*返回值：无返回值。
***作者：王利均
***时间：2018年4月23号。
*****************************************************************************************************/
void flash_read(u32 addr,u8 *pbuff,u8 len)
{
  u8 i;
  for(i = 0;i < len;i++){
    *pbuff = FLASH_ReadByte(addr);
    pbuff++;
    addr++;
  }
}
/*****************************************************************************************************
*程序名：flash_write
***功能：写入指定长度的数据到flash
***参数：参数1：要写入的地址，参数2：要写入的数据，参数3：写入数据长度。
*返回值：无返回值。
***作者：王利均
***时间：2018年4月23号。
*****************************************************************************************************/
void flash_write(u32 addr,u8 *pdat,u8 len)
{
    u8 i;
    for(i = 0;i < len;i++){
        FLASH_ProgramByte(addr,*pdat);
        addr++;
        pdat++;
    }
}
/*****************************************************************************************************
*程序名：flash_erase
***功能：擦除一定长度的数据。
***参数：参数1：要擦除的地址。参数2：擦除多少个数据。
*返回值：无返回值。
***作者：王利均
***时间：2018年4月23号。
*****************************************************************************************************/
void flash_erase(u32 addr,u8 len)
{
    u8 i;
    for(i = 0;i < len;i++){
        FLASH_EraseByte(addr);
        addr++;
    }
}
/*****************************************************************************************************
*程序名：flash_lock
***功能：
***参数：无参数。
*返回值：无返回值。
***作者：王利均
***时间：2018年4月23号。
*****************************************************************************************************/
void flash_lock()
{
    FLASH_Lock(FLASH_MEMTYPE_DATA);	
}
/*******************************************END-FLASH.C***********************************************/
